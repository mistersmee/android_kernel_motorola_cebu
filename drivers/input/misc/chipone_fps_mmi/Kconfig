## drivers/input/misc/chipone_fps_mmi/Kconfig
```kconfig
config CHIPONE_FPS_MMI
	tristate "Chipone Fingerprint sensor device driver"
	default n
	help
		Say Y to enable support for the Chipone Fingerprint sensor MMI driver.
```

## drivers/input/misc/fpc_fps_mmi/Kconfig
```kconfig
config INPUT_FPC1020
 tristate "FPC1020 Fingerprint sensor device driver"
 default n
 help
  Say Y if you want to enable support for the FPC1020 Fingerprint
	sensor.

config INPUT_MISC_FPC1020_SAVE_TO_CLASS_DEVICE
tristate "FPC1020 Fingerprint sensor save to class device feature"
 default n
 help
  Say Y if you want to enable support for the FPC1020 Fingerprint
	sensor save to class device feature.
```

## drivers/input/touchscreen/chipone_tddi_mmi/Kconfig
```kconfig
config CHIPONE_TDDI_MMI
	tristate "Chipone touchscreen TDDI MMI module"
	default n
	help
		Say Y if you want to add support for the Chipone tddi touchscreen
		MMI module.
```

## drivers/media/platform/msm/camera/Kconfig
```kconfig
config CCI_INTF
  tristate "Moto CCI intf module"
  default n
  help
    Say Y if you want to build CCI intf module.
```

## drivers/misc/abov_mmi_overlay/Kconfig
```kconfig
config ABOV_MMI_OVERLAY
	tristate "Abov SAR MMI overlay module"
	depends on I2C
	default n
	help
	  An Abov SAR MMI module. Say Y when you want to support this tool.
```

## drivers/misc/awinic/aw8697/Kconfig
```kconfig
#
# AW8697 Driver
#

config AW8697_HAPTIC
	tristate "Awinic AW8697 haptic driver"
	depends on I2C && INPUT_AWINIC_HAPTIC
	help
	  Say Y here if you have Awinic AW8697 haptic controller
	  chip in your system.

	  If unsure, say N.

	  To compile this driver as a module, choose M here: the
	  module will be called aw8697.
```

## drivers/misc/dts201a/Kconfig
```kconfig
config DTS201A_MMI
	tristate "Partron DTS201A Thermopile Sensor module driver"
	default n
	help
		Say Y if you want to enable support for Partron DTS201A
		Thermopile Sensor module driver.
```

## drivers/misc/mmi_sigprint/Kconfig
```kconfig
config MMI_SIGPRINT
        tristate "MMI SIGPRINT"
        default n
        help
         Say Y here if you have a mmi sigprint compatible
         device connected.

         This driver can also be built as a module.  If so, the module
         will be called mmi_sigprint.
```

## drivers/misc/utag/Kconfig
```kconfig
config MOTO_UTAG
	tristate "Motorola Utag driver"
	default n
	help
		Say Y to build Motorola Utag driver.
```

## drivers/mmi_annotate/Kconfig
```kconfig
config MMI_ANNOTATE
  tristate "Motorola MMI annotate driver"
  default n
  help
    Say Y to enable Motorola MMI annotate driver.
```

## drivers/mmi_info/Kconfig
```kconfig
config MMI_INFO
  tristate "Motorola MMI info driver"
  default n
  help
    Say Y to enable Motorola MMI info driver.
```

## drivers/moto_f_usbnet/Kconfig
```kconfig
config MOTO_USBNET
  tristate "Motorola usbnet driver"
  default n
  help
    Say Y to enable Motorola usbnet driver.
```

## drivers/sensors_class/Kconfig
```kconfig
config SENSORS_CLASS
	tristate "Enable sensors class driver Support"
	default n
	help
		Say Y to enable sensors class driver support.
```

## drivers/tzlog_dump/Kconfig
```kconfig
config TZLOG_DUMP
  tristate "Motorola TZ log dump driver"
  default n
  help
    Say Y to enable Motorola TZ log dump driver.
```

## drivers/watchdog_cpu_ctx/Kconfig
```kconfig
config WATCHDOG_CPU_CTX
  tristate "Motorola CPU watchdog CTX driver"
  default n
  help
    Say Y to build Motorola CPU watchdog CTX driver.
```

## drivers/watchdogtest/Kconfig
```kconfig
config WATCHDOGTEST
  tristate "Motorola CPU watchdog test driver"
  default n
  help
    Say Y to build Motorola CPU watchdog test driver.
```
